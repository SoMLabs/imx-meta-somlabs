## conf/machine/include/visioncb-6ull-std.inc
```bitbake
# Provides the VisionCB-6ULL-STD common settings

MACHINEOVERRIDES =. "mx6:mx6ul:mx6ull:"
IMX_DEFAULT_BSP = "nxp"

include conf/machine/include/imx-base.inc
include conf/machine/include/tune-cortexa7.inc

UBOOT_CONFIG ??= "sd"
UBOOT_CONFIG[sd] = "visionsom_6ull_defconfig,sdcard"

UBOOT_DTB_NAME = "imx6ull-visionsom.dtb"

PREFERRED_VERSION_u-boot-imx = "2019.04"

IMAGE_BOOT_FILES = " \
	${KERNEL_IMAGETYPE} \
	${@make_dtb_boot_files(d)} \
	splash.bmp \
"

SERIAL_CONSOLES = "115200;ttymxc0"
```

## conf/machine/include/visionsom-8mm-cb.inc
```bitbake
# Provides the VisionSOM-8MM-CB common settings
 
MACHINEOVERRIDES =. "mx8:mx8m:mx8mm:"

require conf/machine/include/imx-base.inc
require conf/machine/include/tune-cortexa53.inc

MACHINE_FEATURES += " pci optee"

UBOOT_CONFIG ??= "sd"
UBOOT_CONFIG[sd] = "visionsom_8mm_defconfig,sdcard"
SPL_BINARY = "spl/u-boot-spl.bin"

DDR_FIRMWARE_NAME = "lpddr4_pmu_train_1d_imem.bin lpddr4_pmu_train_1d_dmem.bin lpddr4_pmu_train_2d_imem.bin lpddr4_pmu_train_2d_dmem.bin"

UBOOT_DTB_NAME = "imx8mm-visionsom.dtb"

PREFERRED_VERSION_u-boot-imx = "2020.04"

IMXBOOT_TARGETS = "flash_evk"

SERIAL_CONSOLES = "115200;ttymxc3"

IMAGE_BOOTLOADER = "imx-boot"

LOADADDR = ""
IMX_BOOT_SEEK = "33"

IMAGE_BOOT_FILES = " \
	${KERNEL_IMAGETYPE} \
	${@make_dtb_boot_files(d)} \
"
```

## conf/machine/spacesom-8mplus-cb.conf
```bitbake
#@TYPE: Machine
#@NAME: SoMLabs i.MX8MPlus SpaceSOM-8MPlus-CB
#@SOC: i.MX8MM
#@DESCRIPTION: Machine configuration for SpaceSOM-8MPlus-CB boards with SpaceSOM-8MPlus
#@MAINTAINER: Krzysztof Chojnowski <krzysztof.chojnowski@somlabs.com>

MACHINEOVERRIDES =. "mx8:mx8m:mx8mp:"

require conf/machine/include/imx-base.inc
require conf/machine/include/arm/armv8a/tune-cortexa53.inc

UBOOT_CONFIG = "sd"
UBOOT_CONFIG[sd] = "spacesom_8mplus_defconfig,sdcard"

SPL_BINARY = "spl/u-boot-spl.bin"

DDR_FIRMWARE_VERSION = "202006"
DDR_FIRMWARE_NAME = " \
        lpddr4_pmu_train_1d_dmem_${DDR_FIRMWARE_VERSION}.bin \
        lpddr4_pmu_train_1d_imem_${DDR_FIRMWARE_VERSION}.bin \
        lpddr4_pmu_train_2d_dmem_${DDR_FIRMWARE_VERSION}.bin \
        lpddr4_pmu_train_2d_imem_${DDR_FIRMWARE_VERSION}.bin \
"

UBOOT_CONFIG_BASENAME = "spacesom_8mplus"

UBOOT_DTB_NAME = "spacesom-8mplus.dtb"

IMXBOOT_TARGETS = "flash_evk"

IMX_BOOT_SOC_TARGET = "iMX8MP"

PREFERRED_PROVIDER_virtual/kernel = "linux-imx"
PREFERRED_PROVIDER_virtual/bootloader = "u-boot-imx"

SERIAL_CONSOLES = "115200;ttymxc3"

IMAGE_BOOTLOADER = "imx-boot"

ATF_PLATFORM = "imx8mp"
ATF_LOAD_ADDR = "0x970000"

LOADADDR = ""
IMX_BOOT_SEEK = "32"

IMAGE_BOOT_FILES = " \
        ${KERNEL_IMAGETYPE} \
        ${@make_dtb_boot_files(d)} \
"

KERNEL_DEVICETREE = "\
  freescale/spacesom-8mplus-cb-adv.dtb \
"

MACHINE_FEATURES += " pci wifi bluetooth"

MACHINE_EXTRA_RRECOMMENDS += "murata-1zm-firmware"

KERNEL_MODULE_AUTOLOAD += "moal"
KERNEL_MODULE_PROBECONF += "moal"
module_conf_moal = "options moal mod_para=nxp/wifi_mod_para.conf"
```

## conf/machine/titansbc-8mmini.conf
```bitbake
#@TYPE: Machine
#@NAME: SoMLabs i.MX8MM TitanSBC-8Mmini
#@SOC: i.MX8MM
#@DESCRIPTION: Machine configuration for TitanSBC-8Mmini boards
##@MAINTAINER: Krzysztof Chojnowski <krzysztof.chojnowski@somlabs.com>

MACHINEOVERRIDES =. "mx8:mx8m:mx8mm:"

require conf/machine/include/imx-base.inc
require conf/machine/include/arm/armv8a/tune-cortexa53.inc

UBOOT_CONFIG ??= "sd"
UBOOT_CONFIG[sd] = "titansbc_8mmini_defconfig,sdcard"
SPL_BINARY = "spl/u-boot-spl.bin"

DDR_FIRMWARE_NAME = "lpddr4_pmu_train_1d_imem.bin lpddr4_pmu_train_1d_dmem.bin lpddr4_pmu_train_2d_imem.bin lpddr4_pmu_train_2d_dmem.bin"

UBOOT_DTB_NAME = "imx8mm-titansbc.dtb"

IMXBOOT_TARGETS = "flash_evk"

IMX_BOOT_SOC_TARGET = "iMX8MM"

PREFERRED_PROVIDER_virtual/kernel = "linux-imx"
PREFERRED_PROVIDER_virtual/bootloader = "u-boot-imx"

SERIAL_CONSOLES = "115200;ttymxc3"

IMAGE_BOOTLOADER = "imx-boot"

ATF_PLATFORM = "imx8mm"
ATF_LOAD_ADDR = "0x920000"

LOADADDR = ""
IMX_BOOT_SEEK = "33"

IMAGE_BOOT_FILES = " \
        ${KERNEL_IMAGETYPE} \
        ${@make_dtb_boot_files(d)} \
"

KERNEL_DEVICETREE = "freescale/titansbc-8mmini.dtb"

MACHINE_FEATURES += " pci "
```

## conf/machine/visioncb-6ull-std-emmc-btwifi.conf
```bitbake
#@TYPE: Machine
#@NAME: SoMLabs i.MX6ULL VisionCB-6ULL-STD-EMMC-BTWIFI
#@SOC: i.MX6ULL
#@DESCRIPTION: Machine configuration for VisionCB-6ULL-STD board 
#              with VisionSOM-6ULL eMMC memory and wireless modem version
#@MAINTAINER: Krzysztof Chojnowski <krzysztof.chojnowski@somlabs.com>

MACHINEOVERRIDES =. "visioncb-6ull-std:"

include conf/machine/include/visioncb-6ull-std.inc

KERNEL_DEVICETREE = "visioncb-6ull-std-emmc-btwifi.dtb"

MACHINE_FEATURES += "wifi bluetooth"
IMAGE_INSTALL_append = " linux-firmware-bcm43430"
                     
```

## conf/machine/visioncb-6ull-std-emmc.conf
```bitbake
#@TYPE: Machine
#@NAME: SoMLabs i.MX6ULL VisionCB-6ULL-STD-EMMC
#@SOC: i.MX6ULL
#@DESCRIPTION: Machine configuration for VisionCB-6ULL-STD board 
#              with VisionSOM-6ULL eMMC memory version
#@MAINTAINER: Krzysztof Chojnowski <krzysztof.chojnowski@somlabs.com>

MACHINEOVERRIDES =. "visioncb-6ull-std:"

include conf/machine/include/visioncb-6ull-std.inc

KERNEL_DEVICETREE = "visioncb-6ull-std-emmc.dtb"
```

## conf/machine/visioncb-6ull-std-nand2g.conf
```bitbake
#@TYPE: Machine
#@NAME: SoMLabs i.MX6ULL VisionCB-6ULL-STD-SD
#@SOC: i.MX6ULL
#@DESCRIPTION: Machine configuration for VisionCB-6ULL-STD board
#              with VisionSOM-6ULL NAND 2G version
#@MAINTAINER: Krzysztof Chojnowski <krzysztof.chojnowski@somlabs.com>

MACHINEOVERRIDES =. "mx6:mx6ul:mx6ull:visioncb-6ull-std-nand:"

require conf/machine/include/imx-base.inc
require conf/machine/include/arm/armv7a/tune-cortexa7.inc

IMAGE_FSTYPES += " ubi"
UBI_VOLNAME = "rootfs"

UBOOT_CONFIG = "sd"
UBOOT_CONFIG[sd] = "visionsom_6ull_defconfig,sdcard"
UBOOT_DTB_NAME = "imx6ull-visionsom.dtb"

PREFERRED_PROVIDER_virtual/kernel = "linux-imx"
PREFERRED_PROVIDER_virtual/bootloader = "u-boot-imx"

SERIAL_CONSOLES = "115200;ttymxc0"

IMAGE_BOOT_FILES = " \
        ${KERNEL_IMAGETYPE} \
        ${@make_dtb_boot_files(d)} \
"

KERNEL_DEVICETREE = "\
  visioncb-6ull-std-nand.dtb \
  visioncb-6ull-std-nand-btwifi.dtb \
"

MACHINE_FEATURES += "wifi bluetooth bcm43430"

BCM_FIRMWARE_SUFFIX = "somlabs,visionsom-6ull"

MKUBIFS_ARGS = "--min-io-size 2048 --leb-size 126976 --max-leb-cnt 2100"
UBINIZE_ARGS = "--min-io-size 2048 --peb-size 131072 --sub-page-size 2048"
MXSBOOT_NAND_ARGS = "-w 2045 -o 128 -e 131072"
```

## conf/machine/visioncb-6ull-std-nand4g.conf
```bitbake
#@TYPE: Machine
#@NAME: SoMLabs i.MX6ULL VisionCB-6ULL-STD-SD
#@SOC: i.MX6ULL
#@DESCRIPTION: Machine configuration for VisionCB-6ULL-STD board
#              with VisionSOM-6ULL NAND 4G version
#@MAINTAINER: Krzysztof Chojnowski <krzysztof.chojnowski@somlabs.com>

MACHINEOVERRIDES =. "mx6:mx6ul:mx6ull:visioncb-6ull-std-nand:"

require conf/machine/include/imx-base.inc
require conf/machine/include/arm/armv7a/tune-cortexa7.inc

IMAGE_FSTYPES += " ubi"
UBI_VOLNAME = "rootfs"

UBOOT_CONFIG = "sd"
UBOOT_CONFIG[sd] = "visionsom_6ull_defconfig,sdcard"
UBOOT_DTB_NAME = "imx6ull-visionsom.dtb"

PREFERRED_PROVIDER_virtual/kernel = "linux-imx"
PREFERRED_PROVIDER_virtual/bootloader = "u-boot-imx"

SERIAL_CONSOLES = "115200;ttymxc0"

IMAGE_BOOT_FILES = " \
        ${KERNEL_IMAGETYPE} \
        ${@make_dtb_boot_files(d)} \
"

KERNEL_DEVICETREE = "\
  visioncb-6ull-std-nand.dtb \
  visioncb-6ull-std-nand-btwifi.dtb \
"

MACHINE_FEATURES += "wifi bluetooth bcm43430"

BCM_FIRMWARE_SUFFIX = "somlabs,visionsom-6ull"

MKUBIFS_ARGS = "--min-io-size 4096 --leb-size 253952 --max-leb-cnt 2100"
UBINIZE_ARGS = "--min-io-size 4096 --peb-size 262144 --sub-page-size 4096"
MXSBOOT_NAND_ARGS = "-w 4096 -o 224 -e 262144"
```

## conf/machine/visioncb-6ull-std-sd-btwifi.conf
```bitbake
#@TYPE: Machine
#@NAME: SoMLabs i.MX6ULL VisionCB-6ULL-STD-SD-BTWIFI
#@SOC: i.MX6ULL
#@DESCRIPTION: Machine configuration for VisionCB-6ULL-STD board 
#              with VisionSOM-6ULL SD-card and wireless modem version
#@MAINTAINER: Krzysztof Chojnowski <krzysztof.chojnowski@somlabs.com>

MACHINEOVERRIDES =. "visioncb-6ull-std:"

include conf/machine/include/visioncb-6ull-std.inc

KERNEL_DEVICETREE = "visioncb-6ull-std-sd-btwifi.dtb"

MACHINE_FEATURES += "wifi bluetooth"
IMAGE_INSTALL_append = " linux-firmware-bcm43430"
                     
```

## conf/machine/visioncb-6ull-std-sd.conf
```bitbake
#@TYPE: Machine
#@NAME: SoMLabs i.MX6ULL VisionCB-6ULL-STD-SD
#@SOC: i.MX6ULL
#@DESCRIPTION: Machine configuration for VisionCB-6ULL-STD board 
#              with VisionSOM-6ULL SD-card version
#@MAINTAINER: Krzysztof Chojnowski <krzysztof.chojnowski@somlabs.com>

MACHINEOVERRIDES =. "visioncb-6ull-std:"

include conf/machine/include/visioncb-6ull-std.inc

KERNEL_DEVICETREE = "visioncb-6ull-std-sd.dtb"
```

## conf/machine/visionsom-8mm-cb-std.conf
```bitbake
#@TYPE: Machine
#@NAME: SoMLabs i.MX8MM VisionCB-8M-STD
#@SOC: i.MX8MM
#@DESCRIPTION: Machine configuration for VisionCB-8M-STD board with VisionSOM-8MM
#@MAINTAINER: Krzysztof Chojnowski <krzysztof.chojnowski@somlabs.com>

MACHINEOVERRIDES =. "visionsom-8mm-cb:"

include conf/machine/include/visionsom-8mm-cb.inc

KERNEL_DEVICETREE = "freescale/visionsom-8mm-cb-std.dtb"

MACHINE_FEATURES += "wifi bluetooth bcm43430"
```

## conf/machine/visionsom-8mm-cb.conf
```bitbake
#@TYPE: Machine
#@NAME: SoMLabs i.MX8MM VisionCB-8M
#@SOC: i.MX8MM
#@DESCRIPTION: Machine configuration for VisionCB-8M boards with VisionSOM-8Mmini
#@MAINTAINER: Krzysztof Chojnowski <krzysztof.chojnowski@somlabs.com>

MACHINEOVERRIDES =. "mx8:mx8m:mx8mm:"

require conf/machine/include/imx-base.inc
require conf/machine/include/tune-cortexa53.inc

UBOOT_CONFIG = "sd"
UBOOT_CONFIG[sd] = "visionsom_8mm_defconfig,sdcard"

SPL_BINARY = "spl/u-boot-spl.bin"

DDR_FIRMWARE_NAME = "\
        lpddr4_pmu_train_1d_imem.bin \
        lpddr4_pmu_train_1d_dmem.bin \
        lpddr4_pmu_train_2d_imem.bin \
        lpddr4_pmu_train_2d_dmem.bin \
"

UBOOT_DTB_NAME = "imx8mm-visionsom.dtb"

IMXBOOT_TARGETS = "flash_evk"

IMX_BOOT_SOC_TARGET = "iMX8MM"

SERIAL_CONSOLES = "115200;ttymxc3"

IMAGE_BOOTLOADER = "imx-boot"

ATF_PLATFORM = "imx8mm"
ATF_LOAD_ADDR = "0x920000"

LOADADDR = ""
IMX_BOOT_SEEK = "33"

IMAGE_BOOT_FILES = " \
        ${KERNEL_IMAGETYPE} \
        ${@make_dtb_boot_files(d)} \
"

KERNEL_DEVICETREE = "\
  freescale/visionsom-8mm-cb-std.dtb \
  freescale/visionsom-8mm-cb-std-hdmi.dtb \
  freescale/visionsom-8mm-cb-std-lvds.dtb \
  freescale/visionsom-8mm-cb-std-mipi10.dtb \
  freescale/visionsom-8mm-cb-std-mipi7.dtb \
  freescale/visionsom-8mm-cb-adv.dtb \
  freescale/visionsom-8mm-cb-adv-hdmi.dtb \
  freescale/visionsom-8mm-cb-adv-lvds.dtb \
  freescale/visionsom-8mm-cb-adv-mipi10.dtb \
  freescale/visionsom-8mm-cb-adv-mipi7.dtb \
"

MACHINE_FEATURES += " pci wifi bluetooth bcm43430"
```

## conf/machine/visionsom6ull.conf
```bitbake
#@TYPE: Machine
#@NAME: SoMLabs i.MX6ULL VisionSOM-6ULL
#@SOC: i.MX6ULL
#@DESCRIPTION: Machine configuration for VisionSOM-6ULL
#@MAINTAINER: Krzysztof Chojnowski <krzysztof.chojnowski@somlabs.com>

MACHINEOVERRIDES =. "mx6:mx6ul:mx6ull:"

include conf/machine/include/imx-base.inc
include conf/machine/include/tune-cortexa7.inc

KERNEL_DEVICETREE = "somlabs-visionsom-6ull.dtb \
                     somlabs-visionsom-6ull-emmc.dtb"

UBOOT_CONFIG ??= "sd"
UBOOT_CONFIG[sd] = "somlabs_visionsom_6ull_defconfig"

PREFERRED_PROVIDER_virtual/bootloader_visionsom6ull = "u-boot-somlabs"

IMAGE_BOOT_FILES = " \
	${KERNEL_IMAGETYPE} \
	${@make_dtb_boot_files(d)} \
	splash.bmp \
"

SERIAL_CONSOLES = "115200;ttymxc0"

MACHINE_FEATURES += "wifi bluetooth"
IMAGE_INSTALL_append = " linux-firmware-bcm43430"
```

## recipes-bsp/u-boot/u-boot-imx/visionsom_8mm_defconfig
```kconfig
CONFIG_ARM=y
CONFIG_ARCH_IMX8M=y
CONFIG_SYS_TEXT_BASE=0x40200000
CONFIG_SYS_MALLOC_F_LEN=0x2000
CONFIG_TARGET_SOMLABS_VISIONSOM_8MM=y
CONFIG_VISIOSOM_8MM_MEMORY_K4F6E304HBMGCJ=y
CONFIG_SPL_MMC_SUPPORT=y
CONFIG_SPL_SERIAL_SUPPORT=y
CONFIG_SPL=y
CONFIG_NR_DRAM_BANKS=1
CONFIG_FIT=y
CONFIG_FIT_EXTERNAL_OFFSET=0x3000
CONFIG_SPL_LOAD_FIT=y
CONFIG_SPL_FIT_GENERATOR="arch/arm/mach-imx/mkimage_fit_atf.sh"
CONFIG_OF_BOARD_SETUP=y
CONFIG_SYS_EXTRA_OPTIONS="IMX_CONFIG=arch/arm/mach-imx/imx8m/imximage.cfg,SPL_TEXT_BASE=0x7E1000"
CONFIG_CONSOLE_MUX=y
CONFIG_DEFAULT_FDT_FILE="visionsom-8mm.dtb"
CONFIG_ARCH_MISC_INIT=y
CONFIG_SPL_BOARD_INIT=y
CONFIG_SPL_USB_HOST_SUPPORT=y
CONFIG_SPL_USB_GADGET=y
CONFIG_SPL_USB_SDP_SUPPORT=y
CONFIG_HUSH_PARSER=y
CONFIG_CMD_MEMTEST=y
# CONFIG_CMD_FLASH is not set
CONFIG_CMD_GPIO=y
CONFIG_CMD_I2C=y
CONFIG_CMD_CACHE=y
CONFIG_CMD_REGULATOR=y
CONFIG_CMD_EXT2=y
CONFIG_CMD_EXT4=y
CONFIG_CMD_EXT4_WRITE=y
CONFIG_CMD_FAT=y
CONFIG_OF_CONTROL=y
CONFIG_DEFAULT_DEVICE_TREE="visionsom-8mm"
CONFIG_NET_RANDOM_ETHADDR=y
CONFIG_USB_FUNCTION_FASTBOOT=y
CONFIG_FASTBOOT_BUF_ADDR=0x42800000
CONFIG_FASTBOOT_BUF_SIZE=0x40000000
CONFIG_FASTBOOT_FLASH=y
CONFIG_DM_GPIO=y
CONFIG_DM_I2C=y
CONFIG_SYS_I2C_MXC=y
CONFIG_LED=y
CONFIG_LED_BLINK=y
CONFIG_LED_GPIO=y
CONFIG_DM_MMC=y
CONFIG_MMC_IO_VOLTAGE=y
CONFIG_MMC_UHS_SUPPORT=y
CONFIG_MMC_HS400_ES_SUPPORT=y
CONFIG_MMC_HS400_SUPPORT=y
# CONFIG_MMC_VERBOSE is not set
CONFIG_DM_ETH=y
CONFIG_RGMII=y
CONFIG_PINCTRL=y
CONFIG_PINCTRL_IMX8M=y
CONFIG_DM_PMIC=y
CONFIG_DM_PMIC_PCA9450=y
CONFIG_DM_REGULATOR=y
CONFIG_DM_REGULATOR_FIXED=y
CONFIG_DM_REGULATOR_GPIO=y
CONFIG_CONS_INDEX=3
CONFIG_DM_THERMAL=y
CONFIG_NXP_TMU=y
CONFIG_USB=y
CONFIG_DM_USB=y
CONFIG_USB_EHCI_HCD=y
CONFIG_USB_GADGET=y
CONFIG_USB_GADGET_MANUFACTURER="FSL"
CONFIG_USB_GADGET_VENDOR_NUM=0x0525
CONFIG_USB_GADGET_PRODUCT_NUM=0xa4a5
CONFIG_CI_UDC=y
CONFIG_SDP_LOADADDR=0x40400000
```
