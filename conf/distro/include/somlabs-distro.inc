## conf/distro/include/somlabs-distro.inc
```bitbake
PREFERRED_PROVIDER_virtual/kernel:somlabs = "linux-imx"
PREFERRED_VERSION_linux-imx:somlabs = "6.18.20"

INIT_MANAGER = "systemd"

DISTRO_FEATURES:remove = "directfb nfs"
```

## conf/distro/somlabs-fb.conf
```bitbake
require conf/distro/include/fsl-base.inc
require conf/distro/include/somlabs-distro.inc

DISTRO = "somlabs-fb"
DISTRO_NAME = "SoMLabs framebuffer"

DISTRO_FEATURES:remove = "x11 wayland vulkan"
```

## conf/distro/somlabs-xwayland.conf
```bitbake
require conf/distro/include/fsl-base.inc
require conf/distro/include/somlabs-distro.inc

DISTRO = "somlabs-xwayland"
DISTRO_NAME = "SoMLabs Wayland with XWayland"

DISTRO_FEATURES:append = " x11 wayland pam"
```

## conf/machine/include/somlabs.inc
```bitbake
PREFERRED_PROVIDER_virtual/bootloader:somlabs = "u-boot-imx"
PREFERRED_VERSION_u-boot-imx:somlabs = "2025.04"
PREFERRED_VERSION_imx-atf:somlabs = "2.12"
SOC_ATF_BOOT_UART_BASE:somlabs = "0x30a60000"

#PREFERRED_VERSION_gstreamer1.0:somlabs = "1.26.%"
#PREFERRED_VERSION_gstreamer1.0-plugins-base:somlabs = "1.26.%"
#PREFERRED_VERSION_gstreamer1.0-plugins-bad:somlabs = "1.26.%"
#PREFERRED_VERSION_gstreamer1.0-plugins-good:somlabs = "1.26.%"
#PREFERRED_VERSION_gstreamer1.0-plugins-ugly:somlabs = "1.26.%"
#PREFERRED_VERSION_gstreamer1.0-libav:somlabs = "1.26.%"
#PREFERRED_VERSION_gstreamer1.0-rtsp-server:somlabs = "1.26.%"
```

## conf/machine/somlabs-aiot-box-8mplus.conf
```bitbake
#@TYPE: Machine
#@NAME: SoMLabs i.MX8MPlus AIoT Box
#@SOC: i.MX8MPlus
#@DESCRIPTION: Machine configuration for AIoT Box boards with SpaceSOM-8MPlus
#@MAINTAINER: Krzysztof Chojnowski <krzysztof.chojnowski@somlabs.com>

MACHINEOVERRIDES =. "mx8:mx8m:mx8mp:somlabs:"

require conf/machine/include/imx-base.inc
require conf/machine/include/arm/armv8a/tune-cortexa53.inc
require conf/machine/include/somlabs.inc

UBOOT_CONFIG = "sd"
UBOOT_CONFIG[sd] = "somlabs_aiot_box_8mplus_defconfig"
UBOOT_CONFIG_IMAGE_FSTYPES[sd] = "sdcard"

SPL_BINARY = "spl/u-boot-spl.bin"

DDR_FIRMWARE_VERSION = "202006"
DDR_FIRMWARE_NAME = " \
        lpddr4_pmu_train_1d_dmem_${DDR_FIRMWARE_VERSION}.bin \
        lpddr4_pmu_train_1d_imem_${DDR_FIRMWARE_VERSION}.bin \
        lpddr4_pmu_train_2d_dmem_${DDR_FIRMWARE_VERSION}.bin \
        lpddr4_pmu_train_2d_imem_${DDR_FIRMWARE_VERSION}.bin \
"

UBOOT_CONFIG_BASENAME = "spacesom_8mplus"
UBOOT_DTB_NAME = "spacesom-8mplus.dtb"
UBOOT_SUFFIX = "bin"

IMXBOOT_TARGETS = "flash_evk"

IMX_BOOT_SOC_TARGET = "iMX8MP"

SERIAL_CONSOLES = "115200;ttymxc3"

IMAGE_BOOTLOADER = "imx-boot"

ATF_PLATFORM = "imx8mp"
ATF_LOAD_ADDR = "0x970000"

LOADADDR = ""
IMX_BOOT_SEEK = "32"

IMAGE_BOOT_FILES = " \
        ${KERNEL_IMAGETYPE} \
        ${@make_dtb_boot_files(d)} \
"

KERNEL_DEVICETREE = "\
  freescale/somlabs-aiot-box-8mplus.dtb \
"

MACHINE_FEATURES += " pci wifi bluetooth"
MACHINE_EXTRA_RRECOMMENDS += " linux-firmware-murata-1zm kernel-module-nxp-wlan"
```

## conf/machine/somlabs-iot-box-6ull.conf
```bitbake
#@TYPE: Machine
#@NAME: SoMLabs IoT-BOX
#@SOC: i.MX6ULL
#@DESCRIPTION: Machine configuration for SoMLabs IoT-BOX board
#              with VisionSOM-6ULL module
#@MAINTAINER: Krzysztof Chojnowski <krzysztof.chojnowski@somlabs.com>

MACHINEOVERRIDES =. "mx6:mx6ul:mx6ull:somlabs:"

require conf/machine/include/imx-base.inc
require conf/machine/include/arm/armv7a/tune-cortexa7.inc
require conf/machine/include/somlabs.inc

UBOOT_CONFIG = "sd"
UBOOT_CONFIG[sd] = "somlabs_iot_box_6ull_defconfig,sdcard"
UBOOT_DTB_NAME = "imx6ull-somlabs-iot-box.dtb"
UBOOT_MAKE_TARGET = "u-boot.imx"
UBOOT_SUFFIX = "imx"

SERIAL_CONSOLES = "115200;ttymxc0"

IMAGE_BOOT_FILES = " \
        ${KERNEL_IMAGETYPE} \
        ${@make_dtb_boot_files(d)} \
"

KERNEL_DEVICETREE = "\
  nxp/imx/somlabs-iot-box-6ull.dtb \
"
```

## conf/machine/starsbc-6ull.conf
```bitbake
#@TYPE: Machine
#@NAME: SoMLabs i.MX6ULL StarSBC-6ULL
#@SOC: i.MX6ULL
#@DESCRIPTION: Machine configuration for StarSBC-6ULL module
#              with or without the COMM board
#@MAINTAINER: Krzysztof Chojnowski <krzysztof.chojnowski@somlabs.com>

MACHINEOVERRIDES =. "mx6:mx6ul:mx6ull:somlabs:"

require conf/machine/include/imx-base.inc
require conf/machine/include/arm/armv7a/tune-cortexa7.inc
require conf/machine/include/somlabs.inc

UBOOT_CONFIG = "sd"
UBOOT_CONFIG[sd] = "starsbc_6ull_defconfig,sdcard"
UBOOT_DTB_NAME = "imx6ull-somlabs-starsbc.dtb"
UBOOT_MAKE_TARGET = "u-boot.imx"
UBOOT_SUFFIX = "imx"

SERIAL_CONSOLES = "115200;ttymxc0"

IMAGE_BOOT_FILES = " \
        ${KERNEL_IMAGETYPE} \
        ${@make_dtb_boot_files(d)} \
"

KERNEL_DEVICETREE = "\
  nxp/imx/starsbc-6ull.dtb \
  nxp/imx/starsbc-6ull-shield-comm.dtb \
"

MACHINE_FEATURES += " wifi bluetooth "
MACHINE_EXTRA_RRECOMMENDS += "linux-firmware-murata-1dx"

BCM_FIRMWARE_SUFFIX = "somlabs,starsbc-6ull"
```

## conf/machine/starsom-8mp-cb.conf
```bitbake
#@TYPE: Machine
#@NAME: SoMLabs i.MX8MPlus StarSOM-8MP-CB
#@SOC: i.MX8MM
#@DESCRIPTION: Machine configuration for StarSOM-8MP-CB boards with StarSOM-8MP
#@MAINTAINER: Krzysztof Chojnowski <krzysztof.chojnowski@somlabs.com>

MACHINEOVERRIDES =. "mx8:mx8m:mx8mp:somlabs:"

require conf/machine/include/imx-base.inc
require conf/machine/include/arm/armv8a/tune-cortexa53.inc
require conf/machine/include/somlabs.inc

UBOOT_CONFIG = "sd"
UBOOT_CONFIG[sd] = "starsom_8mp_defconfig"
UBOOT_CONFIG_IMAGE_FSTYPES[sd] = "sdcard"

SPL_BINARY = "spl/u-boot-spl.bin"

DDR_FIRMWARE_VERSION = "202006"
DDR_FIRMWARE_NAME = " \
        lpddr4_pmu_train_1d_dmem_${DDR_FIRMWARE_VERSION}.bin \
        lpddr4_pmu_train_1d_imem_${DDR_FIRMWARE_VERSION}.bin \
        lpddr4_pmu_train_2d_dmem_${DDR_FIRMWARE_VERSION}.bin \
        lpddr4_pmu_train_2d_imem_${DDR_FIRMWARE_VERSION}.bin \
"

UBOOT_CONFIG_BASENAME = "starsom_8mp"
UBOOT_DTB_NAME = "starsom-8mp.dtb"
UBOOT_SUFFIX = "bin"

IMXBOOT_TARGETS = "flash_evk"

IMX_BOOT_SOC_TARGET = "iMX8MP"

SERIAL_CONSOLES = "115200;ttymxc0"

IMAGE_BOOTLOADER = "imx-boot"

ATF_PLATFORM = "imx8mp"
ATF_LOAD_ADDR = "0x970000"
# we are using UART1 for console
SOC_ATF_BOOT_UART_BASE:somlabs := "0x30860000"

LOADADDR = ""
IMX_BOOT_SEEK = "32"

IMAGE_BOOT_FILES = " \
        ${KERNEL_IMAGETYPE} \
        ${@make_dtb_boot_files(d)} \
"

KERNEL_DEVICETREE = "\
  freescale/starsom-8mp-cb-adv.dtb \
"

MACHINE_FEATURES += " pci"
```

## conf/machine/starsom-cb-6ull.conf
```bitbake
#@TYPE: Machine
#@NAME: SoMLabs i.MX6ULL StarSOM-CB-6ULL
#@SOC: i.MX6ULL
#@DESCRIPTION: Machine configuration for StarSOM-6ULL module
#              with StarCB-6ULL carrier board
#@MAINTAINER: Krzysztof Chojnowski <krzysztof.chojnowski@somlabs.com>

MACHINEOVERRIDES =. "mx6:mx6ul:mx6ull:somlabs:"

require conf/machine/include/imx-base.inc
require conf/machine/include/arm/armv7a/tune-cortexa7.inc
require conf/machine/include/somlabs.inc

UBOOT_CONFIG = "sd"
UBOOT_CONFIG[sd] = "starsom_6ull_defconfig"
UBOOT_CONFIG_IMAGE_FSTYPES[sd] = "sdcard"

UBOOT_DTB_NAME = "imx6ull-somlabs-starsom.dtb"
UBOOT_MAKE_TARGET = "u-boot.imx"
UBOOT_SUFFIX = "imx"

SERIAL_CONSOLES = "115200;ttymxc3"

IMAGE_BOOT_FILES = " \
        ${KERNEL_IMAGETYPE} \
        ${@make_dtb_boot_files(d)} \
        splash.bmp \
"

KERNEL_DEVICETREE = "\
  nxp/imx/starsom-cb-6ull-emmc.dtb \
  nxp/imx/starsom-cb-6ull-emmc-btwifi.dtb \
  nxp/imx/starsom-cb-6ull-sd.dtb \
  nxp/imx/starsom-cb-6ull-sd-btwifi.dtb \
"

MACHINE_FEATURES += " wifi bluetooth "
MACHINE_EXTRA_RRECOMMENDS += "linux-firmware-murata-1dx"

BCM_FIRMWARE_SUFFIX = "somlabs,starsom-6ull"
```

## conf/machine/visioncb-6ull-std.conf
```bitbake
#@TYPE: Machine
#@NAME: SoMLabs i.MX6ULL VisionCB-6ULL-STD-SD
#@SOC: i.MX6ULL
#@DESCRIPTION: Machine configuration for VisionCB-6ULL-STD board 
#              with VisionSOM-6ULL SD-card version
#@MAINTAINER: Krzysztof Chojnowski <krzysztof.chojnowski@somlabs.com>

MACHINEOVERRIDES =. "mx6:mx6ul:mx6ull:somlabs:"

require conf/machine/include/imx-base.inc
require conf/machine/include/arm/armv7a/tune-cortexa7.inc
require conf/machine/include/somlabs.inc

UBOOT_CONFIG = "sd"
UBOOT_CONFIG[sd] = "visionsom_6ull_defconfig"
UBOOT_CONFIG_IMAGE_FSTYPES[sd] = "sdcard"

UBOOT_DTB_NAME = "imx6ull-visionsom.dtb"
UBOOT_MAKE_TARGET = "u-boot.imx"
UBOOT_SUFFIX = "imx"

SERIAL_CONSOLES = "115200;ttymxc0"

IMAGE_BOOT_FILES = " \
        ${KERNEL_IMAGETYPE} \
        ${@make_dtb_boot_files(d)} \
        splash.bmp \
"

KERNEL_DEVICETREE = "\
  nxp/imx/visioncb-6ull-std-emmc.dtb \
  nxp/imx/visioncb-6ull-std-emmc-btwifi.dtb \
  nxp/imx/visioncb-6ull-std-sd.dtb \
  nxp/imx/visioncb-6ull-std-sd-btwifi.dtb \
"

MACHINE_FEATURES += " wifi bluetooth "
MACHINE_EXTRA_RRECOMMENDS += "linux-firmware-murata-1dx"

BCM_FIRMWARE_SUFFIX = "somlabs,visionsom-6ull"
```

## conf/machine/visionsom-imx91.conf
```bitbake
#@TYPE: Machine
#@NAME: SoMLabs i.MX91 VisionSOM-IMX91
#@SOC: i.MX91
#@DESCRIPTION: Machine configuration for VisionCB-IMX91 boards with VisionSOM-IMX91
#@MAINTAINER: Krzysztof Chojnowski <krzysztof.chojnowski@somlabs.com>

MACHINEOVERRIDES =. "mx91:somlabs:"

require conf/machine/include/imx-base.inc
require conf/machine/include/arm/armv8-2a/tune-cortexa55.inc
require conf/machine/include/somlabs.inc

UBOOT_CONFIG = "sd"
UBOOT_CONFIG[sd] = "visionsom-imx91_defconfig"
UBOOT_CONFIG_IMAGE_FSTYPES[sd] = "sdcard"

SPL_BINARY = "spl/u-boot-spl.bin"

DDR_FIRMWARE_NAME = " \
    lpddr4_dmem_1d_v202201.bin \
    lpddr4_dmem_2d_v202201.bin \
    lpddr4_imem_1d_v202201.bin \
    lpddr4_imem_2d_v202201.bin \
"

UBOOT_CONFIG_BASENAME = "visionsom-imx91"
UBOOT_DTB_NAME = "visionsom-imx91.dtb"
UBOOT_SUFFIX = "bin"

IMXBOOT_TARGETS = "flash_singleboot"

IMX_BOOT_SOC_TARGET = "iMX91"

SERIAL_CONSOLES = "115200;ttyLP0"
IMX_DEFAULT_BSP = "nxp"

IMAGE_BOOTLOADER = "imx-boot"

ATF_PLATFORM = "imx91"

LOADADDR = ""
IMX_BOOT_SEEK = "32"

IMAGE_BOOT_FILES = " \
        ${KERNEL_IMAGETYPE} \
        ${@make_dtb_boot_files(d)} \
"

KERNEL_DEVICETREE = "\
  freescale/visionsom-imx91-cb-std.dtb \
"

MACHINE_FEATURES += " pci wifi bluetooth"
MACHINE_EXTRA_RRECOMMENDS += "linux-firmware-murata-1dx"

BCM_FIRMWARE_SUFFIX = "somlabs,visionsom-imx91"
```

## conf/machine/visionsom-imx93.conf
```bitbake
#@TYPE: Machine
#@NAME: SoMLabs i.MX93 VisionSOM-IMX93
#@SOC: i.MX93
#@DESCRIPTION: Machine configuration for VisionCB-IMX93 boards with VisionSOM-IMX93
#@MAINTAINER: Krzysztof Chojnowski <krzysztof.chojnowski@somlabs.com>

MACHINEOVERRIDES =. "mx93:somlabs:"

require conf/machine/include/imx-base.inc
require conf/machine/include/arm/armv8-2a/tune-cortexa55.inc
require conf/machine/include/somlabs.inc

UBOOT_CONFIG = "sd"
UBOOT_CONFIG[sd] = "visionsom-imx93_defconfig,sdcard"

SPL_BINARY = "spl/u-boot-spl.bin"

DDR_FIRMWARE_NAME = " \
    lpddr4_dmem_1d_v202201.bin \
    lpddr4_dmem_2d_v202201.bin \
    lpddr4_imem_1d_v202201.bin \
    lpddr4_imem_2d_v202201.bin \
"

UBOOT_CONFIG_BASENAME = "visionsom-imx93"
UBOOT_DTB_NAME = "visionsom-imx93.dtb"
UBOOT_SUFFIX = "bin"

IMXBOOT_TARGETS = "flash_singleboot"

IMX_BOOT_SOC_TARGET = "iMX9"

SERIAL_CONSOLES = "115200;ttyLP0"
IMX_DEFAULT_BSP = "nxp"

IMAGE_BOOTLOADER = "imx-boot"

ATF_PLATFORM = "imx93"

LOADADDR = ""
IMX_BOOT_SEEK = "32"

IMAGE_BOOT_FILES = " \
        ${KERNEL_IMAGETYPE} \
        ${@make_dtb_boot_files(d)} \
"

KERNEL_DEVICETREE = "\
  freescale/visionsom-imx93-cb-std.dtb \
  freescale/visionsom-imx93-cb-std-lvds-rvt70hslnwc00-b.dtb \
  freescale/visionsom-imx93-cb-std-mipi-rvt70hsmnwc00.dtb \
"

MACHINE_FEATURES += " pci wifi bluetooth"
MACHINE_EXTRA_RRECOMMENDS += "linux-firmware-murata-1dx"

BCM_FIRMWARE_SUFFIX = "somlabs,visionsom-imx93"
```
